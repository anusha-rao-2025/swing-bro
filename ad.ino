/* 
  SwingBro -> Arduino IoT Cloud integration
  - Requires: thingProperties.h generated by the Cloud Thing
  - Cloud variables expected (create them in the Thing):
      float backMs;
      float downMs;
      float ratio;
      float tempoOK;   // 1.0 = OK, 0.0 = not OK
      int swings;
*/

#include "thingProperties.h"   // generated by Arduino IoT Cloud
#include <Arduino.h>
#include <math.h>

// Hardware pins
const int motorPin = 27; // transistor control for motor
const int xPin = 36;
const int yPin = 39;
const int zPin = 34;

// Detection params (tweak if needed)
const float MOTION_START_G    = 1.05f;
const float MOTION_END_G      = 1.00f;
const float AXIS_VEL_HELPER   = 0.045f;
const float EMA_ALPHA         = 0.25f;
const unsigned long MIN_BACK_MS       = 120;
const unsigned long MIN_DOWN_MS_SAFE  = 100;
const unsigned long MAX_BACK_MS_CAP   = 1200;
const unsigned long MAX_SWING_MS      = 3000;
const unsigned long DIR_SUSTAIN_MS = 40;
const unsigned long AXIS_IMPULSE_SUSTAIN_MS = 30;
const float MIN_REASONABLE_RATIO = 0.5f;
const float MAX_REASONABLE_RATIO = 8.0f;
const unsigned long MOTOR_DURATION_MS = 400;

// allowed ratio range (changeable via serial commands)
float allowedRatioMin = 2.50f;
float allowedRatioMax = 3.50f;

// State machine
enum State { IDLE, BACKSWING, DOWNSWING } state = IDLE;

// Runtime smoothing
float smX = 0.0f, smY = 0.0f, smZ = 0.0f, smMag = 1.0f;
float lastX = 0.0f;

// Timing / debounce
unsigned long dirNegStart = 0;
unsigned long dirPosStart = 0;
unsigned long axisImpulseStart = 0;
unsigned long backswingStart = 0;
unsigned long backswingEnd = 0;
unsigned long downswingStart = 0;
unsigned long downswingEnd = 0;

// motor
bool motorOn = false;
unsigned long motorStart = 0;

// local counters (mirrors Cloud swings)
int swingsLocal = 0;

// helpers
float rawG_fromRaw(int raw) {
  return ((float)raw / 4095.0f - 0.5f) * 6.0f;
}

void readAndSmooth() {
  int xr = analogRead(xPin);
  int yr = analogRead(yPin);
  int zr = analogRead(zPin);
  float xg = rawG_fromRaw(xr);
  float yg = rawG_fromRaw(yr);
  float zg = rawG_fromRaw(zr);
  float mag = sqrtf(xg*xg + yg*yg + zg*zg);

  smX = EMA_ALPHA * xg + (1.0f - EMA_ALPHA) * smX;
  smY = EMA_ALPHA * yg + (1.0f - EMA_ALPHA) * smY;
  smZ = EMA_ALPHA * zg + (1.0f - EMA_ALPHA) * smZ;
  smMag = EMA_ALPHA * mag + (1.0f - EMA_ALPHA) * smMag;
}

void vibrateMotor() {
  digitalWrite(motorPin, HIGH);
  motorOn = true;
  motorStart = millis();
  Serial.println("MOTOR ON (vibrate)");
}
void stopMotorIfNeeded(unsigned long now) {
  if (motorOn && (now - motorStart >= MOTOR_DURATION_MS)) {
    digitalWrite(motorPin, LOW);
    motorOn = false;
    Serial.println("MOTOR OFF");
  }
}

void setPreset(const String &p) {
  if (p.equalsIgnoreCase("beginner")) { allowedRatioMin = 2.20f; allowedRatioMax = 3.90f; }
  else if (p.equalsIgnoreCase("intermediate")) { allowedRatioMin = 2.50f; allowedRatioMax = 3.50f; }
  else if (p.equalsIgnoreCase("pro")) { allowedRatioMin = 2.90f; allowedRatioMax = 3.10f; }
  Serial.print("Preset applied: "); Serial.println(p);
  Serial.print("Allowed range: "); Serial.print(allowedRatioMin,2); Serial.print(" - "); Serial.println(allowedRatioMax,2);
}

void handleSerialCommands() {
  if (!Serial.available()) return;
  String s = Serial.readStringUntil('\n');
  s.trim();
  if (s.length() == 0) return;
  String lc = s; lc.toLowerCase();

  if (lc.startsWith("preset ")) { String p = s.substring(7); p.trim(); setPreset(p); return; }
  if (lc.startsWith("set ")) {
    float a=0,b=0; int parsed = sscanf(s.c_str()+4, "%f %f", &a, &b);
    if (parsed == 2 && a>0 && b>a) { allowedRatioMin = a; allowedRatioMax = b; Serial.print("Custom range: "); Serial.print(a); Serial.print(" - "); Serial.println(b); }
    else { Serial.println("Bad format. Use: set <min> <max>"); }
    return;
  }
  if (lc == "show") { Serial.print("Allowed: "); Serial.print(allowedRatioMin,2); Serial.print(" - "); Serial.println(allowedRatioMax,2); return; }
  Serial.println("Commands: preset <name>, set <min> <max>, show");
}

// ----------------- Setup & Cloud init -----------------
void setup() {
  pinMode(motorPin, OUTPUT);
  digitalWrite(motorPin, LOW);
  analogReadResolution(12);
  Serial.begin(115200);
  delay(150);

  // seed smoothing
  int xr = analogRead(xPin), yr = analogRead(yPin), zr = analogRead(zPin);
  float xg = rawG_fromRaw(xr), yg = rawG_fromRaw(yr), zg = rawG_fromRaw(zr);
  smX = xg; smY = yg; smZ = zg; smMag = sqrtf(xg*xg + yg*yg + zg*zg);
  lastX = smX;

  // Initialize Cloud properties and connect
  initProperties();                          // generated by Arduino Cloud Thing
  ArduinoCloud.begin(ArduinoIoTPreferredConnection);
  setDebugMessageLevel(2);
  ArduinoCloud.printDebugInfo();

  Serial.println("SwingBro -> Cloud-enabled 3:1 detector started");
  setPreset("intermediate");
  Serial.print("Allowed range: "); Serial.print(allowedRatioMin,2); Serial.print(" - "); Serial.println(allowedRatioMax,2);
}

// ----------------- Main loop -----------------
void loop() {
  unsigned long now = millis();

  // keep cloud alive
  ArduinoCloud.update();

  handleSerialCommands();
  stopMotorIfNeeded(now);
  readAndSmooth();

  // axis delta helper
  float axisDelta = smX - lastX;
  lastX = smX;

  // Debounce direction
  if (smX < -0.10f) { if (dirNegStart == 0) dirNegStart = now; } else dirNegStart = 0;
  if (smX >  0.10f) { if (dirPosStart == 0) dirPosStart = now; } else dirPosStart = 0;
  if (axisDelta < -AXIS_VEL_HELPER) { if (axisImpulseStart == 0) axisImpulseStart = now; } else axisImpulseStart = 0;

  bool motionActive = smMag > MOTION_START_G;

  switch (state) {
    case IDLE:
      if ( (dirNegStart != 0 && (now - dirNegStart) >= DIR_SUSTAIN_MS && motionActive) ||
           (axisImpulseStart != 0 && (now - axisImpulseStart) >= AXIS_IMPULSE_SUSTAIN_MS && smMag > (MOTION_START_G - 0.10f)) ) {
        state = BACKSWING;
        backswingStart = now;
        Serial.println("STATE -> BACKSWING (started)");
      }
      break;

    case BACKSWING: {
      unsigned long backMsNow = now - backswingStart;
      if (dirPosStart != 0 && (now - dirPosStart) >= DIR_SUSTAIN_MS && smMag > (MOTION_START_G - 0.05f)) {
        if (backMsNow >= MIN_BACK_MS) {
          backswingEnd = now;
          downswingStart = now;
          state = DOWNSWING;
          Serial.print("TRANSITION -> DOWNSWING (backswing ms): ");
          Serial.println(backMsNow);
        } else {
          Serial.print("Backswing too short (");
          Serial.print(backMsNow);
          Serial.println(" ms) -> ABORT to IDLE");
          state = IDLE;
        }
      }
      if (backMsNow > MAX_SWING_MS) { Serial.println("Backswing timeout -> reset to IDLE"); state = IDLE; }
      break;
    }

    case DOWNSWING: {
      unsigned long downMsNow = now - downswingStart;
      if ((smMag < MOTION_END_G && downMsNow >= MIN_DOWN_MS_SAFE) || downMsNow > MAX_SWING_MS) {
        downswingEnd = now;

        // rename locals so we can assign to Cloud vars properly
        unsigned long backMsLocal = backswingEnd - backswingStart;
        unsigned long downMsLocal = downswingEnd - downswingStart;

        unsigned long downMsSafe = max(downMsLocal, MIN_DOWN_MS_SAFE);
        unsigned long backMsForRatio = min(backMsLocal, MAX_BACK_MS_CAP);
        float ratioVal = (float)backMsForRatio / (float)downMsSafe;

        Serial.print("BackMs="); Serial.print(backMsLocal);
        Serial.print(" DownMs="); Serial.print(downMsLocal);
        Serial.print(" (used for ratio: back="); Serial.print(backMsForRatio);
        Serial.print(" down="); Serial.print(downMsSafe);
        Serial.print(") Ratio="); Serial.println(ratioVal, 2);

        if (ratioVal < MIN_REASONABLE_RATIO || ratioVal > MAX_REASONABLE_RATIO) {
          Serial.println("Invalid ratio detected -> discarding swing");
          state = IDLE;
          break;
        }

        bool ok = (ratioVal >= allowedRatioMin && ratioVal <= allowedRatioMax);
        if (!ok) {
          if (ratioVal < allowedRatioMin) {
            Serial.print("Tempo too FAST (ratio < "); Serial.print(allowedRatioMin,2); Serial.print("). Deviation: ");
            Serial.println(allowedRatioMin - ratioVal, 2);
          } else {
            Serial.print("Tempo too SLOW (ratio > "); Serial.print(allowedRatioMax,2); Serial.print("). Deviation: ");
            Serial.println(ratioVal - allowedRatioMax, 2);
          }
          vibrateMotor();
        } else {
          Serial.println("Tempo OK (within allowed range)");
        }

        // --- Update local + Cloud variables here ---
        swingsLocal++;
        swings = swingsLocal;                           // Cloud variable (int)
        backMs = (float)backMsLocal;                   // Cloud variable (float)
        downMs = (float)downMsLocal;                   // Cloud variable (float)
        ratio = ratioVal;                               // Cloud variable (float)
        tempoOK = ok ? 1.0f : 0.0f;                    // Cloud variable (float used as boolean)

        Serial.print("Session swings: "); Serial.println(swingsLocal);

        // Reset to IDLE for next swing
        Serial.println("STATE -> IDLE (ready for next swing)");
        state = IDLE;
      }
      break;
    }
  }

  delay(6); // keep loop fast
}
